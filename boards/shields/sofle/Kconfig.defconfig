## boards/shields/sofle/Kconfig.defconfig
```kconfig
if SHIELD_SOFLE_LEFT

config ZMK_KEYBOARD_NAME
    default "Stelmakh"

config ZMK_SPLIT_ROLE_CENTRAL
    default y

config ZMK_SPLIT_BLE_CENTRAL_PERIPHERALS
    default 3

config BT_MAX_CONN
    default 7

config BT_MAX_PAIRED
    default 7

config ZMK_STUDIO
    default y

config ZMK_STUDIO_LOCKING
    default n  

endif ## SHIELD_SOFLE_LEFT


if SHIELD_SOFLE_RIGHT

config ZMK_SPLIT_ROLE_CENTRAL
    default n

endif ## SHIELD_SOFLE_RIGHT


if SHIELD_SOFLE_LEFT || SHIELD_SOFLE_RIGHT

config ZMK_BLE
    default y

config ZMK_SPLIT
    default y

config ZMK_SLEEP
    default y
    
endif ## SHIELD_SOFLE_LEFT || SHIELD_SOFLE_RIGHT
```
